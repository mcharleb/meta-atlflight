## conf/distro/altflight.conf
```bitbake
DISTRO_VERSION = "0.1+atlflight"

GCCVERSION ?= "linaro-4.8"

IMAGE_FEATURES_append = " debug-tweaks ssh-server-dropbear"

INHERIT += "rm_work"
INHERIT += "buildhistory"
INHERIT += "image-buildinfo"
BUILDHISTORY_COMMIT = "1"

DISTRO_NAME = "ATLFLight"
```

## conf/machine/eagle.conf
```bitbake
#@TYPE: Machine
#@NAME: eagle
#@DESCRIPTION: Intrinsyc Snapdragon Flight (Eagle), with Qualcomm Snapdragon APQ8074

require conf/machine/include/tune-cortexa8.inc

# features
MACHINE_FEATURES = "screen usb keyboard wifi ext2 ext3"

# build the kernel separately for now
PREFERRED_PROVIDER_virtual/kernel = "linux-dummy"
PREFERRED_PROVIDER_kernel-base = "linux-dummy"
PREFERRED_PROVIDER_kernel-image = "linux-dummy"

SERIAL_CONSOLE = "115200 ttyMSM0"

# Fastboot expects an ext4 image, which needs to be 4096 aligned
IMAGE_FSTYPES_append = " ext4.gz"
IMAGE_ROOTFS_ALIGNMENT = "4096"

INHERIT += "qcom-firmware-mount"

#PREFERRED_VERSION_gcc-cross-${TARGET_ARCH} ?= "linaro-4.8%"
PREFERRED_VERSION_gcc                            ?= "linaro-4.8%"
PREFERRED_VERSION_gcc-cross                      ?= "linaro-4.8%"
PREFERRED_VERSION_gcc-cross-initial              ?= "linaro-4.8%"
PREFERRED_VERSION_gcc-cross-intermediate         ?= "linaro-4.8%"
PREFERRED_VERSION_gcc-cross-canadian             ?= "linaro-4.8%"
PREFERRED_VERSION_gcc-crosssdk                   ?= "linaro-4.8%"
PREFERRED_VERSION_gcc-crosssdk-initial           ?= "linaro-4.8%"
PREFERRED_VERSION_gcc-crosssdk-intermediate      ?= "linaro-4.8%"
PREFERRED_VERSION_gcc-runtime                    ?= "linaro-4.8%"
PREFERRED_VERSION_nativesdk-gcc-runtime          ?= "linaro-4.8%"
PREFERRED_VERSION_libgcc                         ?= "linaro-4.8%"
PREFERRED_VERSION_nativesdk-libgcc               ?= "linaro-4.8%"
PREFERRED_VERSION_gcc-cross-canadian-${TRANSLATED_TARGET_ARCH} ?= "linaro-4.8%"
```
